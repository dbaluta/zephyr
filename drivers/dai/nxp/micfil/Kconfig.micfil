## drivers/dai/nxp/micfil/Kconfig.micfil
```kconfig
# Copyright 2024 NXP
# SPDX-License-Identifier: Apache-2.0

config DAI_NXP_MICFIL
	bool "NXP Pulse Density Modulation Microphone Interface (MICFIL) driver"
	default y
	depends on DT_HAS_NXP_DAI_MICFIL_ENABLED
	help
		Select this to enable NXP SAI driver.
```

## drivers/dma/Kconfig.nxp_sdma
```kconfig
# Copyright 2024 NXP
# SPDX-License-Identifier: Apache-2.0

config DMA_NXP_SDMA
	bool "NXP SDMA driver"
	default y
	depends on DT_HAS_NXP_SDMA_ENABLED
	help
		Enable driver for NXP's SDMA IP.

config DMA_NXP_SDMA_BD_COUNT
	int "Number of SDMA buffer descriptors in an allocation pool"
	default 2
	help
          The number of Buffer Descriptors (BD). Each channel has its own statically
	  allocated pool.
```

## dts/bindings/dma/nxp,sdma.yaml
```yaml
# Copyright 2024 NXP
# SPDX-License-Identifier: Apache-2.0

description: NXP enhanced Direct Memory Access (eDMA) node

compatible: "nxp,sdma"

include: [dma-controller.yaml, base.yaml]

properties:
  reg:
    required: true
  "#dma-cells":
    const: 2

# IMPORTANT: if your EDMA version doesn't support channel MUX-ing please
# leave the MUX cell as 0. This is not mandatory for the driver as the
# MUX value will be ignored in this case but all entities using EDMA should
# be consistent in this regard.
dma-cells:
  - channel
  - mux
```
